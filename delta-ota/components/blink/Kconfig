## delta-ota/components/blink/Kconfig
```kconfig
menu "Blink Component"

    config BLINK_LED_GPIO
        int "LED GPIO"
        default 21

    config BLINK_TASK_PRIORITY
        int "Blink Task Priority"
        default 2

    config BLINK_TASK_STACK_SIZE
        int "Blink Task Stack Size in words"
        default 2048

endmenu
```

## delta-ota/components/delta_ota/Kconfig
```kconfig
menu "Delta OTA Configuration"

    config DOTA_FIRMWARE_UPG_URL
        string "Firmware Upgrade URL"
        default "https://raw.githubusercontent.com/FBSeletronica/ESP-IDF_OTA/main/delta-ota/images/https_delta_ota_patch.bin"
        help
            URL of server which hosts the firmware image.

    config DOTA_SKIP_COMMON_NAME_CHECK
        bool "Skip server certificate CN fieldcheck"
        default n
        help
            This allows you to skip the validation of OTA server certificate CN field.

    config DOTA_OTA_RECV_TIMEOUT
        int "OTA Receive Timeout"
        default 5000
        help
            Maximum time for reception

    config DOTA_GPIO_BUTTON
        int "GPIO to trigger OTA"
        default 0

    config DOTA_TASK_PRIORITY
        int "Delta OTA Task Priority"
        default 5

    config DOTA_TASK_STACK_SIZE
        int "Delta OTA Task Stack Size in words"
        default 8192

endmenu
```

## ota-simple/main/Kconfig.projbuild
```kconfig
menu "Example Configuration"

    config EXAMPLE_FIRMWARE_UPGRADE_URL
        string "firmware upgrade url endpoint"
        default "https://192.168.0.73:8070/ota-simple.bin"
        help
            URL of server which hosts the firmware
            image.

    config EXAMPLE_USE_CERT_BUNDLE
        bool "Enable certificate bundle"
        default y
        depends on MBEDTLS_CERTIFICATE_BUNDLE
        help
            Enable trusted root certificate bundle. This approach allows to have
            OTA updates functional with any public server without requirement
            to explicitly add its server certificate.

endmenu
```
